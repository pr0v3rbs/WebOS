## webos3.5_driver/kernel/arch/arm/Kconfig.mstararch
```kconfig
#
# MStar arm-dependent configuration
#
config MSTAR_CHIP
	bool
	default y
	select MSTAR_PORTING_KERNEL_4_4_3
	select MSTAR_PORTING_PLAT
	select MSTAR_8250_DRIVER
	select HAVE_SCHED_CLOCK

config MSTAR_PORTING_KERNEL_4_4_3
	bool
	help
	  necessary changes made in MStar-owned files

config MSTAR_PORTING_PLAT
	bool
	help
	  necessary changes made in kernel source code

config MSTAR_8250_DRIVER
	bool
	help
	  temp workaround for 8250 driver

config MSTAR_HIBERNATE_FUNCTIONS
	bool
	default y if LG_SNAPSHOT_BOOT
	help
	  redefine some functions in hibernate.c

config HAVE_SCHED_CLOCK
	bool
	help
	  for MStar arm-boards

config VMALLOC_END_RESERVE_FOR_UTOPIA2K_MODULE
	hex
	prompt "Reserved for utopia2k kernel module memory"
	default 0x0A000000 if MSTAR_MONACO
        default 0x20000000 if MSTAR_MUNICH
	default 0x20000000 if MSTAR_MUSTANG
	default 0x0

config HOLES_IN_ZONE
	def_bool ARCH_SPARSEMEM_ENABLE

config BUILD_ARM_APPENDED_DTB_IMAGE
	bool "Build a concatenated zImage/dtb by default"
	depends on OF
	help
	  Enabling this option will cause a concatenated zImage and list of
	  DTBs to be built by default (instead of a standalone zImage.)
	  The image will built in arch/arm/boot/zImage-dtb

config BUILD_ARM_APPENDED_DTB_IMAGE_NAMES
	string "Default dtb names"
	depends on BUILD_ARM_APPENDED_DTB_IMAGE
	help
	  Space separated list of names of dtbs to append when
	  building a concatenated zImage-dtb

config MEMORY_START_ADDRESS
	hex "Physical address of the memory starting"
	default 0x20200000 if MSTAR_MUNICH
	default 0x20200000 if MSTAR_MUSTANG

config CACHE_PL310
	bool
	depends on CACHE_L2X0
	default y if CPU_V7 && !(CPU_V6 || CPU_V6K)
	help
	  This option enables optimisations for the PL310 cache
	  controller.

config VMSPLIT_2G_MSTAR_PATCH
	bool
	default n

source "arch/arm/Kconfig.mstarpatch"
```

## webos3.5_driver/kernel/arch/arm/configs/m2_defconfig
```kconfig
# General setup
CONFIG_INIT_ENV_ARG_LIMIT=32
CONFIG_CROSS_COMPILE="arm-lg115x-linux-gnueabi-"
CONFIG_ARM_PATCH_PHYS_VIRT=n
CONFIG_LOCALVERSION_AUTO=n
CONFIG_SYSVIPC=y
CONFIG_SYSVIPC_SYSCTL=y
CONFIG_POSIX_MQUEUE=y
CONFIG_POSIX_MQUEUE_SYSCTL=y
CONFIG_CROSS_MEMORY_ATTACH=n

# Timers subsystem
CONFIG_HIGH_RES_TIMERS=y

# CPU/Task time and stats accounting
CONFIG_TASKSTATS=y
CONFIG_TASK_DELAY_ACCT=y
CONFIG_TASK_XACCT=y
CONFIG_TASK_IO_ACCOUNTING=y

# RCU Subsystem
CONFIG_CGROUPS=y
CONFIG_CGROUP_DEBUG=y
CONFIG_CGROUP_FREEZER=y
CONFIG_CGROUP_DEVICE=y
CONFIG_CPUSETS=y
CONFIG_CGROUP_CPUACCT=y
CONFIG_MEMCG=y
CONFIG_MEMCG_SWAP=y
CONFIG_MEMCG_KMEM=y
CONFIG_CGROUP_PERF=y
CONFIG_CGROUP_SCHED=y
CONFIG_FAIR_GROUP_SCHED=y
CONFIG_BLK_CGROUP=y
CONFIG_CGROUP_WRITEBACK=y
CONFIG_RELAY=y
CONFIG_BLK_DEV_INITRD=y
CONFIG_INITRAMFS_SOURCE=""
CONFIG_RD_GZIP=y
CONFIG_RD_LZ4=y
CONFIG_RD_BZIP2=n
CONFIG_RD_LZMA=n
CONFIG_RD_XZ=n
CONFIG_RD_LZO=n
CONFIG_SYSCTL_SYSCALL=y
CONFIG_KALLSYMS_ALL=y
CONFIG_EMBEDDED=y

# Kernel Performance Events And Counters
CONFIG_PROFILING=y
CONFIG_SLUB_DEBUG=n
CONFIG_SLUB=y
CONFIG_TRACEPOINTS=y
CONFIG_OPROFILE=y

# MStar Platform Configuration
CONFIG_MSTAR_MUNICH=y
CONFIG_MSTAR_ARM=y
CONFIG_MSTAR_ARM_BD_GENERIC=y

# LG kernel expansion
CONFIG_LG_KERNEL_EXPAND=y
CONFIG_LG_CHANGE=y
CONFIG_LG_SNAPSHOT_BOOT_MSTAR_PATCH=y

# Address Filter Select
CONFIG_MODULES=y
CONFIG_MODULE_UNLOAD=y
CONFIG_MODULE_IGNORE_SUBVER=y
CONFIG_MSTAR_UIMAGE_UC=y
CONFIG_BLK_DEV_INTEGRITY=y

# Partition Types
CONFIG_PARTITION_ADVANCED=y
CONFIG_LGEMMC_PARTITION=y

# IO Schedulers
CONFIG_DEFAULT_IOSCHED="noop"
CONFIG_DEFAULT_NOOP=y
CONFIG_IOSCHED_DEADLINE=n
CONFIG_IOSCHED_CFQ=n

# Mstar platform type
CONFIG_ARCH_MSTAR_CA9=y

# Platform Porting layer
CONFIG_MP_PLATFORM_ARM=y
CONFIG_MP_PLATFORM_FIQ_IRQ_HYP=y
CONFIG_MP_PLATFORM_UTOPIA2K_EXPORT_SYMBOL=y

# MSTAR Android Patch
CONFIG_MP_Android_MSTAR_RC_MAP_DEFINE=n

# MSTAR DEBUG_TOOL
CONFIG_MP_DEBUG_TOOL_COREDUMP_PATH_BOOTARGS_ONLY=y

# MStar STR
CONFIG_MP_MSTAR_STR_BASE=y

# Sync 3.1.10 setting
CONFIG_MP_SYNC_3_1_10_SETTING_VMALLOC_SETTING=y

# ION PATCH
CONFIG_MP_ION_PATCH_CACHE_FLUSH_MOD=n

# Enhane smartbit result
CONFIG_MP_ETHERNET_MSTAR_ICMP_ENHANCE=y

# Antutu relative patch
CONFIG_MP_ANTUTU_MSTAR_HIDE_SCHED_POLICY=n

# NEW UTOPIA 32BIT PATCH
CONFIG_MP_NEW_UTOPIA_32BIT=y

# Processor Features
CONFIG_SWP_EMULATE=n
CONFIG_ARM_ERRATA_643719=n
CONFIG_ARM_ERRATA_754322=y
CONFIG_ARM_ERRATA_775420=y

# Kernel Features
CONFIG_SMP=y
CONFIG_ALIGNMENT_TRAP=y
CONFIG_VMSPLIT_2G=y
CONFIG_NR_CPUS=2
CONFIG_PREEMPT=y
CONFIG_AEABI=y
CONFIG_OABI_COMPAT=n
CONFIG_HIGHMEM=y
CONFIG_KSM=y
CONFIG_ZSMALLOC=y
CONFIG_SECCOMP=y

# Boot options
CONFIG_ZBOOT_ROM_TEXT=0x0
CONFIG_ZBOOT_ROM_BSS=0x0

# At least one emulation must be selected
CONFIG_VFP=y
CONFIG_NEON=y

# Userspace binary formats
CONFIG_CORE_DUMP_DEFAULT_ELF_HEADERS=n

# Power management options
CONFIG_HIBERNATION=y
CONFIG_LG_SNAPSHOT_BOOT=y
CONFIG_SNAPSHOT_IMAGE_COMPRESSION=y
CONFIG_SNAPSHOT_COMPRESS_TYPE="lz4"
CONFIG_LG_SNAPSHOT_SECURE_BOOT=y
CONFIG_LG_INSTANT_BOOT=y
CONFIG_PM_STD_PARTITION="/dev/mmcblk0p43"
CONFIG_PM_DEBUG=y
CONFIG_PM_ADVANCED_DEBUG=y
CONFIG_DPM_WATCHDOG=y

# Networking options
CONFIG_UNIX=y
CONFIG_IP_MULTICAST=y
CONFIG_IP_PNP=y
CONFIG_IP_PNP_DHCP=y
CONFIG_INET_XFRM_MODE_TRANSPORT=n
CONFIG_INET_XFRM_MODE_TUNNEL=n
CONFIG_INET_XFRM_MODE_BEET=n
CONFIG_INET_LRO=n
CONFIG_INET_DIAG=n
CONFIG_NETLABEL=n
CONFIG_NETFILTER=y
CONFIG_NETFILTER_ADVANCED=n

# Core Netfilter Configuration
CONFIG_NETFILTER_NETLINK=y
CONFIG_NETFILTER_NETLINK_LOG=y
CONFIG_NF_CONNTRACK=y
CONFIG_NF_CONNTRACK_PROCFS=n
CONFIG_NF_CONNTRACK_FTP=n
CONFIG_NF_CONNTRACK_IRC=n
CONFIG_NF_CONNTRACK_SIP=n
CONFIG_NF_CT_NETLINK=n
CONFIG_NETFILTER_XTABLES=y

# Xtables combined modules
CONFIG_NETFILTER_XT_MARK=n
CONFIG_NETFILTER_XT_TARGET_LOG=n
CONFIG_NETFILTER_XT_TARGET_NFLOG=n
CONFIG_NETFILTER_XT_TARGET_TCPMSS=n

# Xtables matches
CONFIG_NETFILTER_XT_MATCH_CONNTRACK=n
CONFIG_NETFILTER_XT_MATCH_STATE=n

# IP: Netfilter Configuration
CONFIG_NF_DEFRAG_IPV4=y
CONFIG_NF_CONNTRACK_IPV4=y
CONFIG_IP_NF_IPTABLES=y
CONFIG_IP_NF_FILTER=y
CONFIG_IP_NF_TARGET_REJECT=y
CONFIG_IP_NF_MANGLE=n
CONFIG_NF_NAT_IPV4=y
CONFIG_IP_NF_TARGET_MASQUERADE=y

# IPv6: Netfilter Configuration
CONFIG_NF_DEFRAG_IPV6=m
CONFIG_NF_CONNTRACK_IPV6=m
CONFIG_IP6_NF_IPTABLES=m
CONFIG_DNS_RESOLVER=y

# Network testing
CONFIG_WIRELESS=y
CONFIG_WIRELESS_EXT=y
CONFIG_WEXT_CORE=y
CONFIG_WEXT_PROC=y
CONFIG_WEXT_PRIV=y
CONFIG_CFG80211=y
CONFIG_CFG80211_DEFAULT_PS=n
CONFIG_HAVE_BPF_JIT=y

# Device Drivers
CONFIG_STAGING=y

# Generic Driver Options
CONFIG_UEVENT_HELPER_PATH="/mnt/lg/bin/hotplug"
CONFIG_DEVTMPFS=y
CONFIG_DEVTMPFS_MOUNT=y
CONFIG_DMA_SHARED_BUFFER=y

# Bus devices
CONFIG_CONNECTOR=y
CONFIG_PROC_EVENTS=y
CONFIG_MTD=y
CONFIG_MTD_CMDLINE_PARTS=y

# Mapping drivers for chip access
CONFIG_MTD_COMPLEX_MAPPINGS=y

# Self-contained MTD device drivers
CONFIG_MTD_BLOCK2MTD=y

# LPDDR & LPDDR2 PCM memory drivers
CONFIG_ZRAM=y
CONFIG_BLK_DEV_LOOP=y
CONFIG_BLK_DEV_LOOP_MIN_COUNT=8

# SCSI device support
CONFIG_SCSI=y
CONFIG_SCSI_DMA=y

# SCSI support type (disk, tape, CD-ROM)
CONFIG_BLK_DEV_SD=y
CONFIG_SCSI_LOGGING=y

# SCSI Transports
CONFIG_SCSI_LOWLEVEL=n
CONFIG_TUN=y

# CAIF transport drivers
CONFIG_NET_CADENCE=n
CONFIG_NET_VENDOR_BROADCOM=n

# Distributed Switch Architecture drivers
CONFIG_NET_VENDOR_CIRRUS=n
CONFIG_NET_VENDOR_FARADAY=n
CONFIG_NET_VENDOR_INTEL=n
CONFIG_NET_VENDOR_MARVELL=n
CONFIG_NET_VENDOR_MICREL=n
CONFIG_NET_VENDOR_NATSEMI=n
CONFIG_NET_VENDOR_SEEQ=n
CONFIG_NET_VENDOR_SMSC=n
CONFIG_NET_VENDOR_STMICRO=n
CONFIG_NET_VENDOR_WIZNET=n
CONFIG_PPP=y
CONFIG_PPP_BSDCOMP=y
CONFIG_PPP_DEFLATE=y
CONFIG_PPP_ASYNC=y
CONFIG_PPP_SYNC_TTY=y
CONFIG_USB_NET_DRIVERS=y

# Input device support
CONFIG_INPUT_FF_MEMLESS=y

# Userland interfaces
CONFIG_INPUT_MOUSEDEV_SCREEN_X=1280
CONFIG_INPUT_MOUSEDEV_SCREEN_Y=720
CONFIG_INPUT_JOYDEV=y
CONFIG_INPUT_EVDEV=y

# Input Device Drivers
CONFIG_INPUT_JOYSTICK=y
CONFIG_JOYSTICK_XPAD=y
CONFIG_JOYSTICK_XPAD_FF=y
CONFIG_INPUT_MISC=y
CONFIG_INPUT_UINPUT=y

# Hardware I/O ports

# Character devices
CONFIG_CONSOLE_TRANSLATIONS=n
CONFIG_LEGACY_PTYS=n
CONFIG_DEVKMEM=n

# Serial drivers
CONFIG_SERIAL_8250=y
CONFIG_SERIAL_8250_CONSOLE=y
CONFIG_SERIAL_8250_NR_UARTS=6
CONFIG_SERIAL_8250_RUNTIME_UARTS=6

# Non-8250 serial port support
CONFIG_SERIAL_BCM63XX=n
CONFIG_HW_RANDOM=n

# Enable PHYLIB and NETWORK_PHY_TIMESTAMPING to see the additional clocks.
CONFIG_HWMON=n

# Multifunction device drivers
CONFIG_MEDIA_SUPPORT=y

# Multimedia core support
CONFIG_MEDIA_CAMERA_SUPPORT=y
CONFIG_VIDEOBUF2_CORE=y
CONFIG_VIDEOBUF2_MEMOPS=y
CONFIG_VIDEOBUF2_VMALLOC=y

# Media drivers
CONFIG_MEDIA_USB_SUPPORT=y

# Webcam devices
CONFIG_USB_VIDEO_CLASS=y
CONFIG_USB_GSPCA=n

# Frame buffer Devices
CONFIG_FB=y

# Console display driver support
CONFIG_SOUND=y
CONFIG_SOUND_OSS_CORE=y
CONFIG_SOUND_OSS_CORE_PRECLAIM=y
CONFIG_SND=y
CONFIG_SND_TIMER=m
CONFIG_SND_PCM=m
CONFIG_SND_HWDEP=m
CONFIG_SND_RAWMIDI=m
CONFIG_SND_OSSEMUL=y
CONFIG_SND_MIXER_OSS=m
CONFIG_SND_PCM_OSS=m
CONFIG_SND_PCM_OSS_PLUGINS=y

# HD-Audio
CONFIG_SND_USB_AUDIO=m

# HID support
CONFIG_HIDRAW=y
CONFIG_UHID=y

# Special HID drivers
CONFIG_HID_DRAGONRISE=y
CONFIG_DRAGONRISE_FF=y
CONFIG_HID_LOGITECH=y
CONFIG_LOGITECH_FF=y
CONFIG_LOGIRUMBLEPAD2_FF=y
CONFIG_LOGIWHEELS_FF=y
CONFIG_HID_ZEROPLUS=y
CONFIG_ZEROPLUS_FF=y

# USB HID support
CONFIG_HID_PID=y
CONFIG_USB_HIDDEV=y

# USB Host Controller Drivers
CONFIG_USB_XHCI_HCD=y

# USB Host Controller Drivers
CONFIG_USB_EHCI_HCD=y

# USB Device Class drivers
CONFIG_USB_ACM=y

# NOTE: USB_STORAGE depends on SCSI but BLK_DEV_SD may
# also be needed; see USB_STORAGE Help for more info
CONFIG_USB_STORAGE=y

# USB port drivers
CONFIG_USB_SERIAL=y
CONFIG_USB_SERIAL_GENERIC=y
CONFIG_USB_SERIAL_IPW=y
CONFIG_USB_SERIAL_PL2303=y
CONFIG_USB_SERIAL_SIERRAWIRELESS=y
CONFIG_USB_SERIAL_OPTION=y

# USB Physical Layer drivers
CONFIG_MMC=y

# MMC/SD/SDIO Card Drivers
CONFIG_MMC_BLOCK_MINORS=64

# webOS
CONFIG_WEBOS=y
CONFIG_LOW_MEM_NOTIFY=y

# MStar Driver Configuration

# MStar Device Drivers
CONFIG_MSTAR_ALSA_AUDIO_DRIVER=m
CONFIG_MSTAR_ALSA_AUDIO_DRIVER_DRV=m
CONFIG_MSTAR_ALSA_AUDIO_DRIVER_HAL=m
CONFIG_MSTAR_DEMOD=y
CONFIG_MSTAR_DLMALLOC=y
CONFIG_MSTAR_EMAC=y
CONFIG_ETHERNET_ALBANY=y
CONFIG_DISCONNECT_DELAY_S=1
CONFIG_MSTAR_FB=y
CONFIG_MSTAR_FUSION=y
CONFIG_MSTAR_GPIO=y
CONFIG_MSTAR_IIC=y
CONFIG_MSTAR_IOMAP=y
CONFIG_MSTAR_IR=m
CONFIG_MSTAR_IR_FANTASY_MODE=y
CONFIG_MSTAR_MBX=y
CONFIG_MSTAR_MBX_U2K=y
CONFIG_MSTAR_MMC=y
CONFIG_MSTAR_MPOOL=y
CONFIG_MSTAR_NAND=y
CONFIG_MSTAR_SC=y
CONFIG_MSTAR_SEMUTEX=y
CONFIG_SYSTEM_LG=y
CONFIG_MSTAR_SYSTEM=y
CONFIG_MSTAR_VIF=y

# Android
CONFIG_ANDROID=y
CONFIG_ANDROID_TIMED_OUTPUT=n

# FPGA Configuration Support

# Firmware Drivers

# File systems
CONFIG_EXT2_FS=y
CONFIG_EXT3_FS=y
CONFIG_EXT4_FS=y
CONFIG_FS_POSIX_ACL=y
CONFIG_EXPORTFS=y
CONFIG_DNOTIFY=n
CONFIG_FUSE_FS=y
CONFIG_CUSE=y
CONFIG_OVERLAY_FS=y

# Caches

# CD-ROM/DVD Filesystems

# DOS/FAT/NT Filesystems
CONFIG_FAT_FS=y
CONFIG_MSDOS_FS=y
CONFIG_VFAT_FS=y
CONFIG_FAT_DEFAULT_CODEPAGE=437
CONFIG_FAT_DEFAULT_IOCHARSET="iso8859-1"
CONFIG_NTFS_FS=y

# Pseudo filesystems
CONFIG_PROC_FS=y
CONFIG_TMPFS=y
CONFIG_ECRYPT_FS=y
CONFIG_CRAMFS=y
CONFIG_SQUASHFS=y
CONFIG_SQUASHFS_LZO=y
CONFIG_NFS_FS=y
CONFIG_NFS_V4=y
CONFIG_ROOT_NFS=y
CONFIG_NFSD=y
CONFIG_NFSD_V3=y
CONFIG_NFSD_V4=y
CONFIG_NLS_DEFAULT="utf8"
CONFIG_NLS_CODEPAGE_437=y
CONFIG_NLS_CODEPAGE_949=y
CONFIG_NLS_ASCII=y
CONFIG_NLS_ISO8859_1=y
CONFIG_NLS_UTF8=y

# Kernel hacking

# printk and dmesg options
CONFIG_PRINTK_TIME=y

# Compile-time checks and compiler options
CONFIG_DEBUG_INFO=y
CONFIG_ENABLE_WARN_DEPRECATED=n
CONFIG_ENABLE_MUST_CHECK=n
CONFIG_HEADERS_CHECK=y
CONFIG_DEBUG_SECTION_MISMATCH=y
CONFIG_MAGIC_SYSRQ=y

# Memory Debugging

# Debug Lockups and Hangs
CONFIG_LOCKUP_DETECTOR=y
CONFIG_DETECT_HUNG_TASK=n

# Lock Debugging (spinlocks, mutexes, etc...)
CONFIG_DEBUG_SPINLOCK=y
CONFIG_TRACE_IRQFLAGS=y

# RCU Debugging
CONFIG_TRACING=y
CONFIG_STACK_TRACER=y
CONFIG_BLK_DEV_IO_TRACE=y
CONFIG_TRACER_MAX_TRACE=y
CONFIG_IRQSOFF_TRACER=y
CONFIG_SCHED_TRACER=y
CONFIG_TRACER_SNAPSHOT=y

# Runtime Testing
CONFIG_ARM_UNWIND=n
CONFIG_DEBUG_USER=y

# Security options
CONFIG_KEYS=y
CONFIG_SECURITY=y
CONFIG_SECURITYFS=y
CONFIG_SECURITY_NETWORK=y
CONFIG_SECURITY_PATH=y

# Compression
CONFIG_CRYPTO_DEFLATE=y
CONFIG_CRYPTO_LZ4=y

# Random Number Generation
CONFIG_CRYPTO_HW=n

# Library routines
CONFIG_CRC32_SLICEBY8=n
CONFIG_CRC32_SLICEBY4=y
CONFIG_LZ4_COMPRESS=y
```

## webos3.5_driver/kernel/arch/arm/plat-mstar/Kconfig
```kconfig
if PLAT_MSTAR

menu "MStar MSB25xx PCB Diversity"

choice
	prompt "Board selection"
	default  MS2510DVBT43

config G35
	bool "G35"

config G35MP
	bool "G35MP"

config MS2510ATSC43
	bool "MS2510ATSC43"

config MS2510DVBT43
	bool "MS2510DVBT43"

config MS2516QC7A
	bool "MS2516QC7A"

config MS2516SZ7A
	bool "MS2516SZ7A"

config MS2517QC7D
	bool "MS2517QC7D"

config MSB2510_35
	bool "MSB2510_35"

endchoice
endmenu

config PLAT_MSTAR_SCHED_CLOCK
    def_bool y
    select NEED_MACH_MEMORY_H
    select NEED_MACH_IO_H
    select HAVE_SCHED_CLOCK
    help
      Allow the default sched_clock() to be overloaded at runtime.
      Use this option if you build a kernel for a platform with
      multiplee sched_clock sources, one of which will be selected
      at runtime.

config PLAT_MSTAR_CLCD
    bool

config PLAT_MSTAR_LEDS
    bool

config PLAT_MSTAR_LOCAL_TIMERS
    bool

menu "Mstar platform type"
    depends on ARCH_MSTAR

config ARCH_MSTAR_CA9
    bool "Mstar Cortex-A9 tile"
    select CPU_V7
    select ARM_GIC
    select MIGHT_HAVE_CACHE_L2X0
    select HAVE_PATA_PLATFORM
    select HAVE_ARM_TWD if SMP
    select HAVE_ARM_SCU if SMP

config ARCH_MSTAR_CA7
    bool "Mstar Cortex-A7 tile"
    select CPU_V7
    select ARM_GIC
    select HAVE_PATA_PLATFORM
    select HAVE_ARM_TWD if SMP
    select HAVE_ARM_SCU if SMP
    select MP_CA7_QUAD_CORE_PATCH

config ARCH_MSTAR_CA12
    bool "Mstar Cortex-A12 tile"
    select CPU_V7
    select ARM_GIC
    select HAVE_PATA_PLATFORM
    select HAVE_ARM_TWD if SMP
    select HAVE_ARM_SCU if SMP
endmenu

endif
```

## webos3.5_driver/kernel/drivers/clk/lg1k/Kconfig
```kconfig
config COMMON_CLK_LG1K
	tristate "Clock driver for LG1K SoCs"
	select LG1K_PMS
	---help---
	  This driver supports clocking subsystem on LG Electronics LG1k SoCs.

config COMMON_CLK_LG1313
	tristate "Clock driver for LG1313 CPU-PLL"
	---help---
	  This driver supports clocking subsystem on LGE DTV SoC LG1313.
```
