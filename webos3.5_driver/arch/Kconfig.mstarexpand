## webos3.5_driver/kdriver/kdriver/build/Kconfig
```kconfig
#
# For a description of the syntax of this configuration file,
# see Documentation/kbuild/kconfig-language.txt.
#
mainmenu "Utopia Configuration"

config PORTING_KERNEL_4_4_3
	bool "changes made to support kernel v4.4.3"
	help
	  take reference of kernel config CONFIG_MSTAR_PORTING_KERNEL_4_4_3 as well
	  first used for DMR

choice
	prompt "Mstar CHIP"
    default None

config EMERALD
	bool "Emerald"
	help
	  Select If the operation system is on Emerald. 
	  If unsure, say 'N'.
	  
config EDISON
	bool "Edison"
	help
	  Select If the operation system is on Edison. 
	  If unsure, say 'N'.
	  
config EDEN
	bool "Eden"
	help
	  Select If the operation system is on Eden. 
	  If unsure, say 'N'.
	  
config EIFFEL
	bool "Eiffel"
	help
	  Select If the operation system is on Eiffel
	  If unsure, say 'N'.
	  
config EULER
	bool "Euler"
	help
	  Select If the operation system is on Euler. 
	  If unsure, say 'N'.
	  
config AMETHYST
	bool "Amethyst"
	help
	  Select If the operation system is on Amethyst. 
	  If unsure, say 'N'.
	  
config MACAW12
	bool "Macaw12"
	help
	  Select If the operation system is on Macaw12. 
	  If unsure, say 'N'.

config K1
	bool "K1"
	help
	  Select If the operation system is on K1. 
	  If unsure, say 'N'.

config KERES
	bool "Keres"
	help
	  Select If the operation system is on Keres. 
	  If unsure, say 'N'.

config KIRIN
	bool "Kirin"
	help
	  Select If the operation system is on kirin. 
	  If unsure, say 'N'.

config KRIS
	bool "Kris"
	help
	  Select If the operation system is on kris. 
	  If unsure, say 'N'.

config NIKE
	bool "Nike"
	help
	  Select If the operation system is on Nike.
	  If unsure, say 'N'.

config MADISON
	bool "Madison"
	help
	  Select If the operation system is on Madison.
	  If unsure, say 'N'.

config MIAMI
	bool "Miami"
	help
	  Select If the operation system is on Miami.
	  If unsure, say 'N'.
  	  
config EINSTEIN
	bool "Einstein"
	help
	  Select If the operation system is on Einstein.
	  If unsure, say 'N'.

config NAPOLI
	bool "Napoli"
	help
	  Select If the operation system is on Einstein.
	  If unsure, say 'N'.

config EINSTEIN3
	bool "Einstein3"
	help
	  Select If the operation system is on Einstein3.
	  If unsure, say 'N'.

config KAISER
	bool "Kaiser"
	help
	  Select If the operation system is on Kaiser.
	  If unsure, say 'N'.

config MONACO
	bool "Monaco"
	help
	  Select If the operation system is on Monaco.
	  If unsure, say 'N'.
	  
config CLIPPERS
	bool "Clippers"
	help
	  Select If the operation system is on Clippers.
	  If unsure, say 'N'.

config CELTICS
	bool "Celtics"
	help
	  Select If the operation system is on Celtics.
	  If unsure, say 'N'.

config MUJI
	bool "Muji"
	help
	  Select If the operation system is on Muji.
	  If unsure, say 'N'.

config MUNICH
	bool "Munich"
	help
	  Select If the operation system is on Munich.
	  If unsure, say 'N'.

config MUSTANG
	bool "Mustang"
	help
	  Select If the operation system is on Mustang.
	  If unsure, say 'N'.

endchoice
	  
config CHIP
	string
	default "emerald" if EMERALD
	default "edison" if EDISON
	default "eden" if EDEN
	default "eiffel" if EIFFEL
	default "euler" if EULER
	default "amethyst" if AMETHYST
	default "macaw12" if MACAW12
	default "k1" if K1
	default "keres" if KERES
	default "kirin" if KIRIN
	default "kris" if KRIS
	default "nike" if NIKE
	default "madison" if MADISON
	default "miami" if MIAMI
	default "einstein" if EINSTEIN
	default "napoli" if NAPOLI
	default "einstein3" if EINSTEIN3
	default "kaiser" if KAISER
	default "monaco" if MONACO
	default "clippers" if CLIPPERS
	default "celtics" if CELTICS
	default "muji" if MUJI
	default "munich" if MUNICH
	default "mustang" if MUSTANG
	help
	  Mstar Chip
#
#
#
#
#

menu "Utopia Platform Configuration"

choice
	prompt "CPU Type"
    default None
	
config ARM_CA53
	bool "ARM_CA53"
	select DLMALLOC
	help
	  Select If the architecture of this chip is based on ARM_CA53 architecture. 
	  If unsure, say 'N'.

config ARM_CA12
	bool "ARM_CA12"
	help
	  Select If the architecture of this chip is based on ARM_CA12 architecture. 
	  If unsure, say 'N'.

config ARM_CA9
	bool "ARM_CA9"
	help
	  Select If the architecture of this chip is based on ARM_CA9 architecture. 
	  If unsure, say 'N'.
	  
config ARM_CA7
	bool "ARM_CA7"
	help
	  Select If the architecture of this chip is based on ARM_CA7 architecture. 
	  If unsure, say 'N'.

config MIPS_4KE
	bool "MIPS_4KE"
	help
	  Select If the architecture of this chip is based on MIPS_4KE architecture. 
	  If unsure, say 'N'.

config MIPS_34K
	bool "MIPS_34K"
	help
	  Select If the architecture of this chip is based on MIPS_34K architecture. 
	  If unsure, say 'N'.

config MIPS_74K
	bool "MIPS_74K"
	help
	  Select If the architecture of this chip is based on MIPS_74K architecture. 
	  If unsure, say 'N'.

config AEON
	bool "AEON"
	help
	  Select If the architecture of this chip is based on AEON architecture. 
	  If unsure, say 'N'.

config R2
	bool "R2"
	help
	  Select If the architecture of this chip is based on R2 architecture. 
	  If unsure, say 'N'.
endchoice

config MCU_TYPE
	string
	default "arm_ca53" if ARM_CA53
	default "arm_ca12" if ARM_CA12
	default "arm9" if ARM_CA9
	default "arm_ca7" if ARM_CA7
	default "mips4ke" if MIPS_4KE
	default "mips34k" if MIPS_34K
	default "mips74k" if MIPS_74K
	default "aeon" if AEON
	default "aeon" if R2
	help
	  Select the architecture of this platform. 
#
#
#
#
#
#

choice
	prompt "FPU Type"
    default None

config SOFT
	bool "soft float"
	help
	  Select If the operation system use soft floating point unit. 
	  If unsure, say 'N'.

config HARD
	bool "hard float"
	help
	  Select If the operation system use hard floating point unit. 
	  If unsure, say 'N'.
endchoice

config FPU
	string
	default "soft" if SOFT
	default "hard" if HARD
	help
	  Floating point unit selection
#
#
#
#
#
#

choice
	prompt "OS Type"
    default None
	
config NOS
	bool "Non-os system"
	help
	  Select If the operation system of this chip is Non-os system. 
	  If unsure, say 'N'.
	  
config LINUX
	bool "Linux system"
	help
	  Select If the operation system of this chip is Linux system. 
	  If unsure, say 'N'.

config MS_DEBUG_XC_LOG
bool "xc debug switch"
depends on LINUX
default y
---help---
Enable the xc log switch

config ECOS
	bool "Ecos system"
	help
	  Select If the operation system of this chip is Ecos system. 
	  If unsure, say 'N'.

config NUTTX
	bool "Nuttx system"
	help
	  Select If the operation system of this chip is Nuttx system. 
	  If unsure, say 'N'.
endchoice

config OS_TYPE
	string
	default "nos" if NOS
	default "linux" if LINUX
	default "ecos" if ECOS
	default "nuttx" if NUTTX
	help
	  Select the operation system. 
#
#
#
#
#
#

choice
	prompt "Project extended Flag"
    default None
	
config TVOS
	bool "TVOS"
	help
	  Select If the operation system of this chip is ecos system. 
	  If unsure, say 'N'.
	 
config ANDROID
	bool "Android"
	help
	  Select If the operation system of this chip is ecos system. 
	  If unsure, say 'N'.

config MBOOT
	bool "Mboot"
	help
	  Select If the operation system of this chip is Nuttx system. 
	  If unsure, say 'N'.

config CHAKRA2
	bool "Chakra2"
	help
	  Select If the operation system of this chip is non-os system. 
	  It is a Chakra2-like systems including Chakra2,Chakra3, etc.
	  If unsure, say 'N'.

config PUMABOOT
	bool "PumaBoot"
	help
	  Select If the operation system of this chip is non-os system. 
	  It is a Chakra2-like systems including Pumaboot(BootVideo), etc.
	  If unsure, say 'N'.
endchoice

config EXT_PLATFORM_FLAG
	string
	default "tvos" if TVOS
	default "android" if ANDROID
	default "mboot" if MBOOT
	default "chakra2" if CHAKRA2
	default "pumaboot" if PUMABOOT
	help
	  Select extra platform option. 


#
#
#
#
#
#

choice
	prompt "Kernel Version"
    default None

config KERN_3_1_10
	bool "3.1.10"
	help
	  Select If the Linux Kernel version is 3.1.10 used for kernel driver. 
	  If unsure, say 'N'.

config KERN_3_10_23
	bool "3.10.23"
	help
	  Select If the Linux Kernel version is 3.10.23 used for kernel driver. 
	  If unsure, say 'N'.
endchoice

config KERN_VER
	string
	default "3.1.10" if KERN_3_1_10
	default "3.10.23" if KERN_3_10_23
	help
	  Linux Kernel Version for K-Driver.

config FPGA
	bool "FPGA environment"
	default n

config DLMALLOC
	bool "MsOS use dlmalloc do memory management"
	default n

endmenu
#
#
#
#
#
#


menu "General Setup"

config TOOLCHAIN
	string "CROSS COMPILE"
	default "arm-none-linux-gnueabi"
	help
	  Select the cross compiler 

config ENDIAN
	string "Endian"
	default "mlittle-endian"
	help
	  Select big or little endian

endmenu
#
#
#
#
#

menu "Build Options"

choice
	prompt "LINK_TYPE"
	default None
	
config STATIC
	bool "Static"
	help
	  Select If the operation system of this chip is Nuttx system. 
	  If unsure, say 'N'.
	  
config DYNAMIC
	bool "Dynamic"
	help
	  Select If the operation system of this chip is Nuttx system. 
	  If unsure, say 'N'.
endchoice

config LINK_TYPE
	string
	default "static" if STATIC
	default "dynamic" if DYNAMIC
	help
	  Select the the linking type
#
#
#
#
#

choice
	prompt "MAKE_TYPE"
	default None
	
config LIB
	bool "Lib"
	help
	  Select If the library is built as 'lib' format
	  If unsure, say 'N'.
	  
config EXE
	bool "Exe"
	help
	  Select If the library is built as 'exe' format
	  If unsure, say 'N'.

config LINT
	bool "Lint"
	help
	  Select If the library is built as 'lint' format
	  If unsure, say 'N'.
endchoice

config MAKE_TYPE
	string
	default "lib" if LIB
	default "exe" if EXE
	default "lint" if LINT
	help
	  Make type
#
#
#
#
#

choice
	prompt "Release Type"
	default None
	
config DEBUG
	bool "Debug"
	help
	  Select If the libraries release is on debug level. 
	  If unsure, say 'N'.
	  
config RETAIL
	bool "Retail"
	help
	  Select If the libraries release is on retail level.
	  If unsure, say 'N'.
endchoice

config BLT_TYPE
	string
	default "debug" if DEBUG
	default "retail" if RETAIL
	help
	  Select the type of libraries release.
#
#
#
#
#

choice
	prompt "Debug Level"
	default None
	
config LEVEL_1
	bool "Level 1(HAL)"
	help
	  Select If the operation system of this chip is Nuttx system. 
	  If unsure, say 'N'.
	  
config LEVEL_2
	bool "Level 2(Driver)"
	help
	  Select If the operation system of this chip is Nuttx system. 
	  If unsure, say 'N'.

config LEVEL_3
	bool "Level 3(Middleware)"
	help
	  Select If the operation system of this chip is Nuttx system. 
	  If unsure, say 'N'.
	  
config LEVEL_4
	bool "Level 4(API)"
	help
	  Select If the operation system of this chip is Nuttx system. 
	  If unsure, say 'N'.
	  
config LEVEL_5
	bool "Level 5(Application)"
	help
	  Select If the operation system of this chip is Nuttx system. 
	  If unsure, say 'N'.
endchoice

config DEBUG_LEVEL
	string
	default "1" if LEVEL_1
	default "2" if LEVEL_2
	default "3" if LEVEL_3
	default "4" if LEVEL_4
	default "5" if LEVEL_5
	help
	  Select the debug level
#
#
#
#
#
	  
choice
	prompt "Firmware Type"
	default None
	
config FW_TYPE_EXTERNAL
	bool "external"
	help
	  Select If you want to use external firmware
	  
config FW_TYPE_EMBEDDED
	bool "embedded"
	help
	  Select If you want to use embedded firmware
endchoice
	  
config FW_TYPE
	string
	default "external" if FW_TYPE_EXTERNAL
	default "embedded" if FW_TYPE_EMBEDDED
	help
	  Select If you want to use external or embedded  firmware
#
#
#
#
#
	 
config INCREMENTAL_BUILD
        bool "Incremental Build"
        default n
        help
            Enable incremental Build
endmenu

source "../mxlib/drv/Kconfig"
source "../mxlib/api/Kconfig"
source "../mxlib/utopia_core/Kconfig"
```

## webos3.5_driver/kdriver/kdriver/mxlib/api/mbx/Kconfig
```kconfig
config API_MBX

tristate "MBX"
default y

---help---
Enable compilation option for API MBX
```

## webos3.5_driver/kdriver/kdriver/mxlib/drv/ca2/Kconfig
```kconfig
config DRV_CA2

tristate "CA2"
default n

---help---
Enable compilation option for driver CA
```

## webos3.5_driver/kdriver/kdriver/mxlib/drv/cipher/Kconfig
```kconfig
config DRV_CIPHER

tristate "CIPHER"
default n

---help---
Enable compilation option for driver CIPHER
```

## webos3.5_driver/kdriver/kdriver/mxlib/drv/dip/Kconfig
```kconfig
config DRV_DIP

tristate "DIP"
default n

---help---
Enable compilation option for driver DIP
```

## webos3.5_driver/kdriver/kdriver/mxlib/drv/dscmb2/Kconfig
```kconfig
config DRV_DSCMB2

tristate "DSCMB2"
default n

---help---
Enable compilation option for driver DSCMB

if DRV_DSCMB2
config DSCMB2_NSK_ENABLE
	bool "Enable dscmb2 NSK"
	default n
	help
	  Select if you want to enable dscmb2 NSK. If unsure, say 'N'.

config DSCMB2_MULTI2_ENABLE
	bool "Enable dscmb2 MLUTI2"
	default y
	help
	  Select if you want to enable dscmb2 MULTI2. If unsure, say 'N'.
endif
```

## webos3.5_driver/kdriver/kdriver/mxlib/drv/gpio/Kconfig
```kconfig
config DRV_GPIO

tristate "GPIO"
default n

---help---
Enable compilation option for driver GPIO
```

## webos3.5_driver/kdriver/kdriver/mxlib/drv/hwi2c/Kconfig
```kconfig
config DRV_HWI2C

tristate "HWI2C"
default n

---help---
Enable compilation option for driver HWI2C
```

## webos3.5_driver/kdriver/kdriver/mxlib/drv/minitsp/Kconfig
```kconfig
config DRV_MINITSP

tristate "MINITSP"
default n

---help---
Enable compilation option for driver MINITSP
```

## webos3.5_driver/kdriver/kdriver/mxlib/drv/mpif/Kconfig
```kconfig
config DRV_MPIF

tristate "MPIF"
default n

---help---
Enable compilation option for driver MPIF
```

## webos3.5_driver/kdriver/kdriver/mxlib/drv/pcmcia/Kconfig
```kconfig
config DRV_PCMCIA

tristate "PCMCIA"
default n

---help---
Enable compilation option for driver PCMCIA
```

## webos3.5_driver/kdriver/kdriver/mxlib/drv/wdt/Kconfig
```kconfig
config DRV_WDT

tristate "WDT"
default n

---help---
Enable compilation option for driver WDT
```

## webos3.5_driver/kdriver/kdriver/mxlib/utopia_core/Kconfig
```kconfig
#
# Utopia framework configuration
#

menu "Utoipa framework"

config UTOPIA_TEE
	bool "Flag of CONFIG_UTOPIA_TEE"
	default n

config UTOPIA_FRAMEWORK
	bool "Support for utopia framework"
	default n
if UTOPIA_FRAMEWORK	
    config UTOPIA_FRAMEWORK_KERNEL_DRIVER
    bool "Support for utopia2k framework"
	default n
endif
endmenu
```

## webos3.5_driver/kernel/arch/Kconfig.lgexpand
```kconfig
#
# LG kernel expansion
#
menu "LG kernel expansion"

config LG_KERNEL_EXPAND
	tristate "LG kernel expansion"
	default y
	help
	  support LG kernel expansion

config LG_CHANGE
	bool "LG change"
	depends on LG_KERNEL_EXPAND
	help
	  LG change request

config LG_SNAPSHOT_BOOT_MSTAR_PATCH
	bool "LG snapshot boot patch"
	depends on LG_KERNEL_EXPAND
	help
	  LG snapshot boot patch for MStar chip

endmenu #LG kernel expansion
```
